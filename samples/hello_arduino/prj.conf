## CMakeLists.txt
```
# SPDX-License-Identifier: Apache-2.0

cmake_minimum_required(VERSION 3.20.0)

# get value of NORMALIZED_BOARD_TARGET early
find_package(Zephyr REQUIRED HINTS $ENV{ZEPHYR_BASE} COMPONENTS yaml boards)

if (EXISTS ${CMAKE_CURRENT_LIST_DIR}/../../variants/${NORMALIZED_BOARD_TARGET}/${NORMALIZED_BOARD_TARGET}_${BOARD_REVISION}.overlay)
  set(DTC_OVERLAY_FILE ${CMAKE_CURRENT_LIST_DIR}/../../variants/${NORMALIZED_BOARD_TARGET}/${NORMALIZED_BOARD_TARGET}_${BOARD_REVISION}.overlay)
elseif (EXISTS ${CMAKE_CURRENT_LIST_DIR}/../../variants/${NORMALIZED_BOARD_TARGET}/${NORMALIZED_BOARD_TARGET}.overlay)
  set(DTC_OVERLAY_FILE ${CMAKE_CURRENT_LIST_DIR}/../../variants/${NORMALIZED_BOARD_TARGET}/${NORMALIZED_BOARD_TARGET}.overlay)
endif()

find_package(Zephyr REQUIRED HINTS $ENV{ZEPHYR_BASE})
project(hello_world)

target_sources(app PRIVATE src/app.cpp)

zephyr_compile_options(-Wno-unused-variable -Wno-comment)
```

## prj.conf
```kconfig
CONFIG_CPLUSPLUS=y
CONFIG_ARDUINO_API=y
CONFIG_BOARD_ARDUINO_NANO_33_BLE_SENSE=y    # Ref. Arduino.h for supported boards
```

## src/main.cpp
```c
/*
 * SPDX-License-Identifier: Apache-2.0
 */

#include <Arduino.h>
#include "zephyrSerial.h"


void setup() {
  // put your setup code here, to run once:
  Serial.begin(115200); // dummy as of now, need to study and refer https://docs.zephyrproject.org/latest/hardware/peripherals/uart.html
}
void loop() {
  char c = 'D';
  size_t ret1;
  size_t ret2;
  ret1 = Serial.print(c);
  ret2 = Serial.println("Hello, World!");
  printk("Sizes: %d %d\n", ret1, ret2);
  Serial.println();
  ret1 = Serial.print("My letter is: ");
  ret2 = Serial.println(c);
  printk("Sizes: %d %d\n", ret1, ret2);
  Serial.println();
  char myString[] = "Will it print?";
  ret1 = Serial.println(myString);
  printk("Size: %d \n\n\n", ret1);
  delay(1000); // 1 second delay
}
```

## src/app.cpp
```c
/*
 * SPDX-License-Identifier: Apache-2.0
 */

#include <Arduino.h>
#include "zephyrSerial.h"


void setup() {
  // put your setup code here, to run once:
  Serial.begin(115200); // dummy as of now, need to study and refer https://docs.zephyrproject.org/latest/hardware/peripherals/uart.html
}
void loop() {
  char c = 'D';
  size_t ret1;
  size_t ret2;
  ret1 = Serial.print(c);
  ret2 = Serial.println("Hello, World!");
  printk("Sizes: %zu %zu\n", ret1, ret2);
  Serial.println();
  ret1 = Serial.print("My letter is: ");
  ret2 = Serial.println(c);
  printk("Sizes: %zu %zu\n", ret1, ret2);
  Serial.println();
  char myString[] = "Will it print?";
  ret1 = Serial.println(myString);
  printk("Size: %zu \n\n\n", ret1);
  delay(1000); // 1 second delay
}
```
