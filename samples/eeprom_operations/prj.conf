## CMakeLists.txt
```
# SPDX-License-Identifier: Apache-2.0

cmake_minimum_required(VERSION 3.20.0)

cmake_path(SET ZephyrBase $ENV{ZEPHYR_BASE})
set(DTC_OVERLAY_FILE ${ZephyrBase}/../modules/lib/Arduino-Zephyr-API/variants/${BOARD}/${BOARD}.overlay)

find_package(Zephyr REQUIRED HINTS $ENV{ZEPHYR_BASE})
project(eeprom_operations)

target_sources(app PRIVATE src/app.cpp)

zephyr_compile_options(-Wno-unused-variable -Wno-comment)
```

## prj.conf
```kconfig
CONFIG_GPIO=y
CONFIG_ARDUINO_API=y
CONFIG_SPI=y
CONFIG_EEPROM=yCONFIG_FLASH_PAGE_LAYOUT

CONFIG_PWM=y
CONFIG_ADC=y
CONFIG_GPIO_GET_DIRECTION=y

CONFIG_LOG=y
CONFIG_MAIN_STACK_SIZE=8192
CONFIG_ENTROPY_GENERATOR=y

CONFIG_NVS=y
CONFIG_FLASH=y
CONFIG_FLASH_MAP=y

CONFIG_LOG_MODE_IMMEDIATE=y
CONFIG_NVS_LOG_LEVEL_DBG=y
CONFIG_REBOOT=y
CONFIG_MPU_ALLOW_FLASH_WRITE=y

CONFIG_FLASH_PAGE_LAYOUT=y
```

## src/app.cpp
```c
/*
 * Copyright (c) 2025 Purva Yeshi <purvayeshi550@gmail.com>
 *
 * SPDX-License-Identifier: Apache-2.0
 */

#include <Arduino.h>
#include "EEPROM.h" 

void setup() {

  int data = 1234;  // Example data to store
  int read_data = 0;

  /* Initialize serial communication */
  Serial.begin(115200);
  while (!Serial) {
    ; /* Wait for serial port to connect (needed for boards with native USB) */
  }
  Serial.println("Serial communication initialized");

  /* Initialize EEPROM/NVS */ 
  if (EEPROM.nvs_init() < 0) { 
    Serial.println("NVS initialization failed");
    return;
  }
  Serial.println("NVS initialized");

  /* Write data to EEPROM */
  if (EEPROM.write_data(1, &data, sizeof(data)) < 0) { 
    Serial.println("Failed to write data");
  } else {
    Serial.println("Data written successfully");
  }

  /* Read data from EEPROM */
  if (EEPROM.read_data(1, &read_data, sizeof(read_data)) > 0) { 
    Serial.print("Data read: ");
    Serial.println(read_data);
  } else {
    Serial.println("Failed to read data");
  }
}

void loop() {

}
```
