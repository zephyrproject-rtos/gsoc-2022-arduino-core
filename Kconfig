## Kconfig
```kconfig
#
# Copyright (c) 2022 Dhruva Gole
#
# SPDX-License-Identifier: Apache-2.0
#

config ARDUINO_API
	bool "ARDUINO_API"
	imply CPP
	imply GPIO
	imply I2C
	imply NEWLIB_LIBC_FLOAT_PRINTF
	imply CBPRINTF_FP_SUPPORT
	imply RING_BUFFER
	select UART_INTERRUPT_DRIVEN
	default n

if ARDUINO_API

config USE_ARDUINO_API_RUST_IMPLEMENTATION
	bool "Use Rust implementation API core"
	select RUST

config QEMU_ICOUNT
	bool "QEMU icount mode"
	default n
	depends on QEMU_TARGET

config ARDUINO_API_SERIAL_BUFFER_SIZE
	int "Buffer size for Arduino Serial API"
	default 64

config ARDUINO_ENTRY
	bool "Provide arduino setup and loop entry points"
	default y

config ARDUINO_MAX_TONES
	int "Maximum number of tones that can be played simultaneously with tone()"
	default -1
	help
	  Specify the maximum number of tones that can be played simultaneously with tone().
	  If set to a negative value, the maximum number will be determined from the
	  system's digital pin configuration.
endif
```
